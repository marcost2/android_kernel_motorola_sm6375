## drivers/backlight/ktd3136/Kconfig
```kconfig
config KTD3136_BL
	tristate "KTD3136_BL backlight driver"
	default n
	help
	  Say Y here if you have KTD3136_BL backlight in
	  your system.

	  If unsure, say N.

	  To compile this driver as a module, choose M here: the
	  module will be called ktd3136_bl.
```

## drivers/backlight/sm5350/Kconfig
```kconfig
config SM5350_BL
	tristate "SM5350 backlight driver"
	default n
	help
	  Say Y here if you have SM5350_BL backlight in
	  your system.

	  If unsure, say N.

	  To compile this driver as a module, choose M here: the
	  module will be called sm5350_bl.
```

## drivers/fm/Kconfig
```kconfig
config RADIO_ELNA
	tristate "ELNA FM Radio"
	default n
	help
	  Say Y here if you have ELNA FM Radio in
	  your system.

	  If unsure, say N.

	  To compile this driver as a module, choose M here: the
	  module will be called fm_ctrl.
```

## drivers/input/misc/rbs_fod_mmi/Kconfig
```kconfig
config INPUT_RBS_FOD_MMI
	tristate "RBS FOD fingerprint sensor MMI"
	default n
	help
	 Say Y here if you wish to include support for MMI RBS finger print sensor.
	 If unsure, say N.

config EGIS_PANEL_NOTIFICATIONS
	bool "EGIS panel notifications"
	depends on INPUT_RBS_FOD_MMI
	default n
```

## drivers/input/misc/silead_fps_mmi/Kconfig
```kconfig
config INPUT_SILEAD_FPS_MMI
	tristate "Silead fingerprint sensor MMI"
	default n
	help
	 Say Y here if you wish to include support for MMI Silead finger print sensor.
	 If unsure, say N.
```

## drivers/leds/aw2033/Kconfig
```kconfig
config LEDS_AW2033
	tristate "Awinic AW2033 LED support"
	help
	  Support for Awinic AW2033 LED controller
	  If unsure, say N
```

## drivers/misc/awinic/Kconfig
```kconfig
source "drivers/misc/awinic/aw862x/Kconfig"
source "drivers/misc/awinic/sarsensor/Kconfig"
```

## drivers/power/bq2589x_chg_mmi/Kconfig
```kconfig
#
# BQ2589X Charger Driver
#

config BQ2589X_CHARGER
    tristate "TI BQ2589x Charger Driver"
    depends on MMI_DISCRETE_CHARGER_CLASS
    default n
    help
        Say Y here if you have a bq2589x charging device in
        your system.

        To compile this driver as a module, choose M here: the
        module will be called bq2589x_charger.

config MMI_EXT_CHG_LED
    bool "Enable MMI external charger LED"
    default n
    help
        Say Y here if you have a MMI external charger LED.

        If unsure, say N.
```

## drivers/power/mmi_charger/Kconfig
```kconfig
config MMI_CHARGER
        tristate "MMI CHARGER"
        default n
        help
         Say Y here if you have a mmi charger compatible
         device connected.

         This driver can also be built as a module.  If so, the module
         will be called mmi_charger.

config MMI_QC3P_TURBO_CHARGER
    bool "Enable MMI QC3P Turbo Charger"
    default n
    help
        Say Y here to enable mmi QC3P Turbo Charger.

        If unsure, say N.
```
